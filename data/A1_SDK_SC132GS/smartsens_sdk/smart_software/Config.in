## data/A1_SDK_SC132GS/smartsens_sdk/smart_software/Config.in
```kconfig
# demo app
menu "demos for add new pkgs"

source "$BR2_EXTERNAL_SMART_SOFTWARE_PATH/package/m1_sdk_lib/Config.in"
source "$BR2_EXTERNAL_SMART_SOFTWARE_PATH/package/ssne_ai_demo/Config.in"

endmenu
```

## data/A1_SDK_SC132GS/smartsens_sdk/smart_software/board/m1pro/smartsens_demo_linux_defconfig
```kconfig
CONFIG_WERROR=y
CONFIG_SYSVIPC=y
CONFIG_AUDIT=y
CONFIG_GENERIC_IRQ_DEBUGFS=y
CONFIG_NO_HZ=y
CONFIG_HIGH_RES_TIMERS=y
CONFIG_BPF_SYSCALL=y
CONFIG_PREEMPT=y
CONFIG_LOG_BUF_SHIFT=14
CONFIG_CGROUPS=y
CONFIG_INITRAMFS_SOURCE="${BR_BINARIES_DIR}/rootfs.cpio"
# CONFIG_RD_BZIP2 is not set
# CONFIG_RD_LZMA is not set
# CONFIG_RD_XZ is not set
# CONFIG_RD_LZO is not set
# CONFIG_RD_LZ4 is not set
# CONFIG_RD_ZSTD is not set
CONFIG_BOOT_CONFIG=y
CONFIG_KALLSYMS_ALL=y
CONFIG_EMBEDDED=y
# CONFIG_COMPAT_BRK is not set
CONFIG_SLAB=y
CONFIG_PROFILING=y
CONFIG_ARCH_SMARTSOC=y
# CONFIG_CACHE_L2X0 is not set
# CONFIG_ATAGS is not set
CONFIG_ARM_APPENDED_DTB=y
CONFIG_VFP=y
CONFIG_NEON=y
CONFIG_KERNEL_MODE_NEON=y
CONFIG_PM_DEBUG=y
CONFIG_KPROBES=y
# CONFIG_STRICT_KERNEL_RWX is not set
# CONFIG_STRICT_MODULE_RWX is not set
# CONFIG_GCC_PLUGINS is not set
CONFIG_MODULES=y
CONFIG_MODULE_UNLOAD=y
# CONFIG_BLOCK is not set
CONFIG_CMA=y
CONFIG_CMA_DEBUGFS=y
CONFIG_CMA_SYSFS=y
CONFIG_NET=y
CONFIG_DEVTMPFS=y
CONFIG_DEVTMPFS_MOUNT=y
# CONFIG_FW_LOADER is not set
CONFIG_MTD=y
CONFIG_MTD_SPI_NOR=y
CONFIG_MTD_SPI_NOR_SWP_DISABLE=y
CONFIG_SRAM=y
# CONFIG_INPUT_KEYBOARD is not set
# CONFIG_INPUT_MOUSE is not set
CONFIG_VT_HW_CONSOLE_BINDING=y
# CONFIG_LEGACY_PTYS is not set
CONFIG_SERIAL_SMARTS1=y
# CONFIG_HW_RANDOM is not set
CONFIG_SPI=y
CONFIG_SPI_DEBUG=y
CONFIG_SPI_SIFIVE=m
# CONFIG_HWMON is not set
# CONFIG_HID is not set
# CONFIG_USB_SUPPORT is not set
CONFIG_DMABUF_DEBUG=y
CONFIG_DMABUF_HEAPS=y
CONFIG_DMABUF_SYSFS_STATS=y
CONFIG_DMABUF_HEAPS_SYSTEM=y
CONFIG_DMABUF_HEAPS_CMA=y
# CONFIG_VIRTIO_MENU is not set
# CONFIG_VHOST_MENU is not set
# CONFIG_IOMMU_SUPPORT is not set
# CONFIG_DNOTIFY is not set
CONFIG_PROC_CHILDREN=y
CONFIG_TMPFS=y
CONFIG_CONFIGFS_FS=y
CONFIG_NLS=y
CONFIG_NLS_CODEPAGE_437=m
CONFIG_NLS_CODEPAGE_850=m
CONFIG_NLS_ISO8859_1=y
CONFIG_NLS_ISO8859_15=m
CONFIG_CRC16=y
CONFIG_XZ_DEC=y
# CONFIG_XZ_DEC_X86 is not set
# CONFIG_XZ_DEC_POWERPC is not set
# CONFIG_XZ_DEC_IA64 is not set
# CONFIG_XZ_DEC_SPARC is not set
CONFIG_DMA_CMA=y
CONFIG_CMA_SIZE_MBYTES=0
CONFIG_CMA_ALIGNMENT=2
CONFIG_DEBUG_SLAB=y
CONFIG_DEBUG_KMEMLEAK=y
# CONFIG_DEBUG_KMEMLEAK_AUTO_SCAN is not set
CONFIG_DEBUG_SHIRQ=y
CONFIG_PANIC_ON_OOPS=y
CONFIG_SCHEDSTATS=y
# CONFIG_DEBUG_PREEMPT is not set
CONFIG_FUNCTION_PROFILER=y
CONFIG_STACK_TRACER=y
CONFIG_OSNOISE_TRACER=y
CONFIG_FTRACE_SYSCALLS=y
CONFIG_DEBUG_LL=y
CONFIG_DEBUG_UNCOMPRESS=y
CONFIG_EARLY_PRINTK=y
```

## data/A1_SDK_SC132GS/smartsens_sdk/smart_software/package/m1_sdk_lib/Config.in
```kconfig
config BR2_PACKAGE_M1_SDK_LIB
    bool "m1 sdk lib"
    help
        This is m1 sdk lib with smarts1 external.
```

## data/A1_SDK_SC132GS/smartsens_sdk/smart_software/package/ssne_ai_demo/Config.in
```kconfig
config BR2_PACKAGE_SSNE_AI_DEMO
    bool "SSNE_AI_DEMO test"
    select BR2_PACKAGE_SSNE
    help
        SMARTSENS Neural Engine (SSNE) test app

config BR2_PACKAGE_SSNE_AI_DEMO_APP
    string "ai demo src path"
    default "face_detection"
    help
        SMARTSENS ai app demo

config BR2_M1_SDK_ROOT_PATH
    string "ai demo LIB path"
    default "src/app_demo/face_detection"
    help
        SMARTSENS ai app demo
```

## data/A1_SDK_SC132GS/smartsens_sdk/smart_software/package/ssne_vision_demo/Config.in
```kconfig
config BR2_PACKAGE_SSNE_VISION_DEMO
	bool "ssne_vision_demo (YOLOv8+OSD+Lidar+Debug)"
	select BR2_PACKAGE_SSNE
	help
	  SmartSens integrated vision demo with YOLOv8 object detection,
	  multi-layer OSD overlay, RPLidar obstacle avoidance, and
	  Aurora TCP debug interface (port 9090).

config BR2_M1_VISION_SDK_ROOT_PATH
	string "SDK lib root path (for vision demo)"
	default "opt/m1_sdk/usr"
	help
	  Path relative to BASE_DIR (output/) where SSNE SDK headers (/include)
	  and libs (/lib) are located.
```

## smartsens_sdk/smart_software/configs/smartsens_m1pro_release_defconfig
```kconfig
BR2_arm=y
BR2_cortex_a7=y
BR2_ARM_FPU_NEON_VFPV4=y
BR2_PACKAGE_OVERRIDE_FILE="$(BR2_EXTERNAL_SMART_SOFTWARE_PATH)/local.mk"
BR2_TOOLCHAIN_EXTERNAL=y
BR2_TOOLCHAIN_EXTERNAL_CUSTOM=y
BR2_TOOLCHAIN_EXTERNAL_PATH="$(BR2_EXTERNAL_SMART_SOFTWARE_PATH)/toolchain/glibc-ssp-cpp/arm-smartsens-linux-gnueabihf_sdk-buildroot"
BR2_TOOLCHAIN_EXTERNAL_GCC_10=y
BR2_TOOLCHAIN_EXTERNAL_HEADERS_5_15=y
BR2_TOOLCHAIN_EXTERNAL_CUSTOM_GLIBC=y
# BR2_TOOLCHAIN_EXTERNAL_INET_RPC is not set
BR2_TOOLCHAIN_EXTERNAL_CXX=y
BR2_ROOTFS_DEVICE_CREATION_DYNAMIC_MDEV=y
BR2_ROOTFS_OVERLAY="$(BR2_EXTERNAL_SMART_SOFTWARE_PATH)/board/m1pro/rootfs_overlay"
BR2_LINUX_KERNEL=y
BR2_LINUX_KERNEL_CUSTOM_VERSION=y
BR2_LINUX_KERNEL_CUSTOM_VERSION_VALUE="5.15.24"
BR2_LINUX_KERNEL_USE_CUSTOM_CONFIG=y
BR2_LINUX_KERNEL_CUSTOM_CONFIG_FILE="$(BR2_EXTERNAL_SMART_SOFTWARE_PATH)/board/m1pro/smartsens_demo_linux_defconfig"
BR2_LINUX_KERNEL_APPENDED_ZIMAGE=y
BR2_LINUX_KERNEL_INTREE_DTS_NAME="smartsens-m1-evb"
BR2_LINUX_KERNEL_NEEDS_HOST_OPENSSL=y
BR2_LINUX_KERNEL_NEEDS_HOST_LIBELF=y
BR2_PACKAGE_BUSYBOX_CONFIG="$(BR2_EXTERNAL_SMART_SOFTWARE_PATH)/configs/busybox.config"
BR2_PACKAGE_ELFUTILS=y
# BR2_PACKAGE_IFUPDOWN_SCRIPTS is not set
# BR2_PACKAGE_URANDOM_SCRIPTS is not set
BR2_TARGET_ROOTFS_CPIO_GZIP=y
BR2_TARGET_ROOTFS_INITRAMFS=y
# BR2_TARGET_ROOTFS_TAR is not set
BR2_TARGET_M1_PRO_DTBS=y
BR2_PACKAGE_HOST_DOSFSTOOLS=y
BR2_PACKAGE_HOST_DTC=y
BR2_PACKAGE_HOST_E2FSPROGS=y
BR2_PACKAGE_HOST_GENIMAGE=y
BR2_PACKAGE_HOST_MTOOLS=y
BR2_PACKAGE_M1_SDK_LIB=y
BR2_PACKAGE_SSNE_AI_DEMO=y
BR2_PACKAGE_SSNE_AI_DEMO_APP="face_detection"
BR2_M1_SDK_ROOT_PATH="opt/m1_sdk/usr"
```

## src/buildroot_pkg/package/ssne_ai_demo/Config.in
```kconfig
config BR2_PACKAGE_SSNE_AI_DEMO
	bool "ssne_ai_demo (人脸检测+底盘控制+OSD标签)"
	select BR2_PACKAGE_SSNE
	help
	  SmartSens A1 AI demo application.
	  Features: SCRFD face detection, OSD visualization with labels,
	  STM32 AKM chassis UART control, RPLidar integration.

config BR2_M1_AI_DEMO_SDK_ROOT_PATH
	string "SDK lib root path (for AI demo)"
	default "opt/m1_sdk/usr"
	help
	  Path relative to BASE_DIR (output/) where SSNE SDK headers (/include)
	  and libs (/lib) are located.
```

## src/buildroot_pkg/package/ssne_connection_test/Config.in
```kconfig
config BR2_PACKAGE_SSNE_CONNECTION_TEST
	bool "ssne_connection_test (A1↔STM32 连接测试)"
	select BR2_PACKAGE_SSNE
	help
	  Minimal A1 <-> STM32 connection test.
	  Sends hello + forward command via GPIO UART to verify
	  hardware connectivity and chassis drive chain.

config BR2_M1_CONN_TEST_SDK_ROOT_PATH
	string "SDK lib root path (for connection test)"
	default "opt/m1_sdk/usr"
	help
	  Path relative to BASE_DIR (output/) where SSNE SDK headers (/include)
	  and libs (/lib) are located.
```

## src/buildroot_pkg/package/ssne_face_drive_demo/Config.in
```kconfig
config BR2_PACKAGE_SSNE_FACE_DRIVE_DEMO
	bool "ssne_face_drive_demo (人脸检测+底盘控制兼容性测试)"
	select BR2_PACKAGE_SSNE
	help
	  SmartSens face detection + chassis control compatibility test.
	  Detects faces via SCRFD and sends forward commands to STM32 AKM
	  via GPIO UART. Includes RPLidar obstacle safety check.

config BR2_M1_FACE_DRIVE_SDK_ROOT_PATH
	string "SDK lib root path (for face drive demo)"
	default "opt/m1_sdk/usr"
	help
	  Path relative to BASE_DIR (output/) where SSNE SDK headers (/include)
	  and libs (/lib) are located.
```
